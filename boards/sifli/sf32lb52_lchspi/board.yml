## boards/sifli/sf32lb52_lchspi/board.yml
```yaml
# Copyright (c) 2025 Core Devices LLC
# SPDX-License-Identifier: Apache-2.0

board:
  name: sf32lb52_lchspi
  full_name: SF32LB52-LCHSPI
  vendor: sifli
  socs:
    - name: sf32lb525uc6
```
